## config/boards/shields /tibiboard/Kconfig.defconfig
```kconfig
if SHIELD_TIBIBOARD30_LEFT

config ZMK_KEYBOARD_NAME
    default "tibiboard30"

config ZMK_SPLIT_ROLE_CENTRAL
    default y

endif

if SHIELD_TIBIBOARD30_LEFT || SHIELD_TIBIBOARD30_RIGHT

config ZMK_SPLIT
    default y

endif
if SHIELD_SETTINGS_RESET

config ZMK_SETTINGS_RESET_ON_START
    default y

endif
```
