
#include "tibiboard30.dtsi"

&transform {
    col-offset = <5>;
};

&kscan {
    col-gpios =
        <&gpio0 43 (GPIO_ACTIVE_LOW | GPIO_PULL_UP)>   /* D6 */
        <&gpio0 5  (GPIO_ACTIVE_LOW | GPIO_PULL_UP)>   /* D5 */
        <&gpio0 4  (GPIO_ACTIVE_LOW | GPIO_PULL_UP)>   /* D4 */
        <&gpio0 29 (GPIO_ACTIVE_LOW | GPIO_PULL_UP)>   /* D3 */
        <&gpio0 28 (GPIO_ACTIVE_LOW | GPIO_PULL_UP)>;  /* D2 */
};
